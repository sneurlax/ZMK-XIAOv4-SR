## boards/shields/skree-custom/Kconfig.defconfig
```kconfig
if SHIELD_SKREE-CUSTOM_LEFT

config ZMK_KEYBOARD_NAME
    default "Skree Custom"

config ZMK_SPLIT_ROLE_CENTRAL
    default y

config ZMK_STUDIO
  default y

endif

if SHIELD_SKREE-CUSTOM_LEFT || SHIELD_SKREE-CUSTOM_RIGHT

config ZMK_SPLIT
    default y

endif
```

## boards/shields/skree-custom/Kconfig.shield
```kconfig
# No whitespace after the comma or in your part name!
config SHIELD_SKREE-CUSTOM_LEFT
    def_bool $(shields_list_contains,skree-custom_left)

# No whitespace after the comma or in your part name!
config SHIELD_SKREE-CUSTOM_RIGHT
    def_bool $(shields_list_contains,skree-custom_right)
```

## config/boards/shields/skreecustom/Kconfig.defconfig
```kconfig
if SHIELD_SKREECUSTOM_RIGHT

config ZMK_KEYBOARD_NAME
    default "Skree Custom"

config ZMK_SPLIT_ROLE_CENTRAL
    default y

endif

if SHIELD_SKREECUSTOM_LEFT || SHIELD_SKREECUSTOM_RIGHT

config ZMK_SPLIT
    default y

endif
```
