//NEED to define SR - SCK somehow



&pinctrl {
	spi1_default: spi1_default {
		group1 {
			psels = <NRF_PSEL(SPIM_SCK, 1, 7)>,
				<NRF_PSEL(SPIM_MOSI, 1, 5)>,
		};
	};

	spi1_sleep: spi1_sleep {
		group1 {
			psels = <NRF_PSEL(SPIM_SCK, 1, 7)>,
				<NRF_PSEL(SPIM_MOSI, 1, 5)>,
			low-power-enable;
		};
	};
};